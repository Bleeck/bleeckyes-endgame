#include "bleeckeys.dtsi" // The shared dtsi file is included in the overlay
#include <dt-bindings/led/led.h>

&default_transform {
    col-offset = <3>;
};


&kscan0 {
    col-gpios = <&pro_micro 18 GPIO_ACTIVE_HIGH>,
                <&pro_micro 15 GPIO_ACTIVE_HIGH>,
                <&pro_micro 14 GPIO_ACTIVE_HIGH>,
                <&pro_micro 16 GPIO_ACTIVE_HIGH>,
                <&pro_micro 10 GPIO_ACTIVE_HIGH>;
};
