## config/boards/shields/bleeckeys/Kconfig.defconfig
```kconfig
if SHIELD_BLEECKEYS_LEFT

# Name must be less than 16 characters long!
config ZMK_KEYBOARD_NAME
    default "bleeckeys"

config ZMK_SPLIT_ROLE_CENTRAL
    default y

CONFIG_I2C=y
CONFIG_ZMK_MOUSE=y
CONFIG_INPUT=y
CONFIG_INPUT_PINNACLE=y

endif

if SHIELD_BLEECKEYS_LEFT || SHIELD_BLEECKEYS_RIGHT
CONFIG_LOG_PROCESS_THREAD_STARTUP_DELAY_MS=8000
config ZMK_SPLIT
    default y
endif
```
