#include <behaviors.dtsi>
#include <dt-bindings/zmk/keys.h>
#include <dt-bindings/zmk/bt.h>
#include <dt-bindings/zmk/ext_power.h>
#include <dt-bindings/zmk/pointing.h>
#include <zephyr/dt-bindings/input/input-event-codes.h>
#include <input/processors.dtsi>    

#define QUICK_TAP_MS 125
#define TAPPING_TERM_MS 150
#define SLOW_TAPPING_TERM_MS 350
#define IDLE_TIMEOUT_MS 5000
#define REQ_IDLE_MS 350

#define KEYS_L 0 1 2 3 4 10 11 12 13 14 20 21 22 23 24 31 32 33
#define KEYS_R 5 6 7 8 9 15 16 17 18 19 25 26 27 28 29 36 37 38
#define KEYS_T 34 35 40 41 42 43 44 45 46 47 48
#define L_DEFAULT  0
#define L_NUMPAD   1
#define L_MOUSE    2
#define L_SCROLL   3
#define L_SYSTEM   4



/ {

    keymap {
        compatible = "zmk,keymap";

            default_layer {
                display-name = "BASE";
                bindings = <
&kp Q	&kp W	&kp E	&kp R	&kp T		&kp Y	
>;

            };

 
    };
};